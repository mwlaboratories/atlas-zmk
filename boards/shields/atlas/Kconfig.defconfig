## boards/shields/atlas/Kconfig.defconfig
```kconfig
# Central Side Configuration
#
# The side on which the PS/2 mouse is connected MUST be the central side.
#
# By default zmk configures the LEFT side as the central side. But most people
# want to connect their pointing devices to the RIGHT side.
#
# So, you need to define that the central side is the one to which the
# pointing device is connected to.

if SHIELD_ATLAS_LEFT

config ZMK_KEYBOARD_NAME
    default "Atlas"

config ZMK_SPLIT_ROLE_CENTRAL
    default y

endif

# Options that should be enabled on both sides
if SHIELD_ATLAS_LEFT || SHIELD_ATLAS_RIGHT

config ZMK_SPLIT
    default y

endif

# Disable USB logging for SAMD21 boards (seeeduino_xiao) as USB CDC ACM
# is not properly configured for this board. USB logging is only available
# for nRF52 boards (nice!nano).
# Check for seeeduino_xiao board specifically
if BOARD_SEEEDUINO_XIAO

config ZMK_USB_LOGGING
    default n

endif
```

## config/west.yml
```yaml
manifest:
  remotes:
    - name: badjeff
      url-base: https://github.com/badjeff
    - name: petejohanson
      url-base: https://github.com/petejohanson

  projects:
    - name: zmk
      remote: petejohanson
      revision: core/move-to-zephyr-4-1
      import: app/west.yml

    - name: kb_zmk_ps2_mouse_trackpoint_driver
      remote: badjeff
      revision: main

  self:
    path: config
    
```
